## boards/shields/roBa/Kconfig.defconfig
```kconfig
if SHIELD_ROBA_R

config ZMK_KEYBOARD_NAME
    default "roBa_R"

config ZMK_SPLIT
    default y

config ZMK_SPLIT_ROLE_CENTRAL
    default y

config BT_MIN_CONN_INTERVAL
    default 6

config BT_MAX_CONN_INTERVAL
    default 6

config PMW3610_POLLING_RATE_250_SW
    default y


endif

if SHIELD_ROBA_L

config ZMK_KEYBOARD_NAME
    default "roBa_L"

config ZMK_SPLIT
    default y
# 単位は 1.25ms




endif
```
